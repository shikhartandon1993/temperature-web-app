## app/build/Kconfig/Kconfig.modules
```kconfig
menu "customer-app (/home/shikhar/customer-workspace/customer-app)"
osource "/home/shikhar/customer-workspace/customer-app/Kconfig"
config ZEPHYR_CUSTOMER_APP_MODULE
	bool
	default y
endmenu
menu "cmsis_6 (/home/shikhar/customer-workspace/modules/hal/cmsis_6)"
osource "$(ZEPHYR_CMSIS_6_KCONFIG)"
config ZEPHYR_CMSIS_6_MODULE
	bool
	default y
endmenu
config ZEPHYR_ATMEL_MODULE
	bool
	default y
menu "hal_nordic (/home/shikhar/customer-workspace/modules/hal/nordic)"
osource "$(ZEPHYR_HAL_NORDIC_KCONFIG)"
config ZEPHYR_HAL_NORDIC_MODULE
	bool
	default y

config ZEPHYR_HAL_NORDIC_MODULE_BLOBS
	bool
endmenu
config ZEPHYR_HAL_STM32_MODULE
	bool
	default y

config ZEPHYR_HAL_STM32_MODULE_BLOBS
	bool
```

## app/build/Kconfig/Kconfig.shield
```kconfig
osource "/home/shikhar/customer-workspace/customer-app/boards/shields/*/Kconfig.shield"
```

## app/build/Kconfig/arch/Kconfig
```kconfig
# Load Zephyr Arch Kconfig descriptions.
osource "/home/shikhar/customer-workspace/zephyr/arch/rx/Kconfig"
osource "/home/shikhar/customer-workspace/zephyr/arch/x86/Kconfig"
osource "/home/shikhar/customer-workspace/zephyr/arch/xtensa/Kconfig"
osource "/home/shikhar/customer-workspace/zephyr/arch/sparc/Kconfig"
osource "/home/shikhar/customer-workspace/zephyr/arch/riscv/Kconfig"
osource "/home/shikhar/customer-workspace/zephyr/arch/posix/Kconfig"
osource "/home/shikhar/customer-workspace/zephyr/arch/mips/Kconfig"
osource "/home/shikhar/customer-workspace/zephyr/arch/arm64/Kconfig"
osource "/home/shikhar/customer-workspace/zephyr/arch/arm/Kconfig"
osource "/home/shikhar/customer-workspace/zephyr/arch/arc/Kconfig"
```

## app/build/Kconfig/boards/Kconfig.defconfig
```kconfig
# Load Zephyr board defconfig descriptions.
osource "/home/shikhar/customer-workspace/zephyr/boards/atmel/sam0/same54_xpro/Kconfig.defconfig"
```

## app/build/Kconfig/boards/Kconfig.same54_xpro
```kconfig
# Load board Kconfig descriptions.
osource "/home/shikhar/customer-workspace/zephyr/boards/atmel/sam0/same54_xpro/Kconfig.same54_xpro"
```

## app/build/Kconfig/boards/Kconfig.sysbuild
```kconfig
# Load Sysbuild board Kconfig descriptions.
osource "/home/shikhar/customer-workspace/zephyr/boards/atmel/sam0/same54_xpro/Kconfig.sysbuild"
```
